/*
 * Overlay de Milo: activa la resistencia interna PULL-DOWN del pin 7 del header de 40 pines
 * (GPIO09 = PAC.06, pinmux "soc_gpio59_pac6") para el botón de parada de emergencia.
 * Botón NC entre pin 1 (3.3V) y pin 7: suelto = 1, presionado o cable cortado = 0.
 * Mismo mecanismo que usa jetson-io de NVIDIA (tegra234-p3767-0000+p3509-a02-hdr40.dtbo).
 * nvidia,pull: 0 = sin resistencia, 1 = pull-down, 2 = pull-up.
 */
/dts-v1/;
/plugin/;

/ {
	overlay-name = "Milo boton de emergencia (pin 7 pull-down)";
	compatible = "nvidia,p3768-0000+p3767-0005-super", "nvidia,p3768-0000+p3767-0005";

	fragment@0 {
		target = <&pinmux>;
		__overlay__ {
			pinctrl-names = "default";
			pinctrl-0 = <&milo_estop_pinmux>;
			milo_estop_pinmux: milo-estop-pinmux {
				hdr40-pin7 {
					nvidia,pins = "soc_gpio59_pac6";
					nvidia,function = "aud";
					nvidia,pull = <0x1>;
					nvidia,tristate = <0x0>;
					nvidia,enable-input = <0x1>;
				};
			};
		};
	};
};
